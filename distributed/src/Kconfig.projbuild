## distributed/src/Kconfig.projbuild
```kconfig
menu "** Project Configuration"

    menu "WIFI Configuration"

        config ESP_WIFI_SSID
            string "WiFi SSID"
            default "myssid"
            help
                SSID (network name).

        config ESP_WIFI_PASSWORD
            string "WiFi Password"
            default "mypassword"
            help
                WiFi password (WPA or WPA2).
        
        config ESP_MAXIMUM_RETRY
        int "Maximum retry"
        default 5
        help
            Set the Maximum retry to avoid station reconnecting to the AP unlimited when the AP is really inexistent.

    endmenu

    menu "BROKER Configuration"
        
        config ESP_MQTT_BASE_TOPIC
            string "Base topic"
            default "/fse2021/180122258"

    endmenu

endmenu
```
